## drivers/backlight/Kconfig
```kconfig
config MOTO_LEDS_BACKLIGHT
	bool "Support for Motorola backlight LEDS"

if MOTO_LEDS_BACKLIGHT

source "drivers/backlight/aw99703/Kconfig"

source "drivers/backlight/sm5350/Kconfig"

endif
```

## drivers/input/touchscreen/ili9882_mmi/Kconfig
```kconfig
config TOUCHSCREEN_ILITEK_CHIPSET_MMI
	tristate "Ilitek Touchscreen driver"
	default n
```
